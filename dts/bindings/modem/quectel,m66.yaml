## dts/bindings/modem/quectel,m66.yaml
```yaml
description: Quectel M66 modem

compatible: "quectel,m66"

include: uart-device.yaml

properties:
  mdm-power-gpios:
    type: phandle-array
    required: true

  mdm-dtr-gpios:
    type: phandle-array

  mdm-ri-gpios:
    type: phandle-array
```
